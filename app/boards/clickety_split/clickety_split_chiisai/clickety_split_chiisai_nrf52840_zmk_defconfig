## app/boards/clicketysplit/mnml/Kconfig.clickety_split_mnml_3x5_left
```kconfig
# Copyright (c) 2025 Clickety Split Ltd.
# SPDX-License-Identifier: MIT

config BOARD_CLICKETY_SPLIT_MNML_3X5_LEFT
    select SOC_NRF52840_QIAA
    select ZMK_BOARD_COMPAT
    imply RETAINED_MEM
    imply RETENTION
    imply RETENTION_BOOT_MODE
```

## app/boards/clicketysplit/mnml/Kconfig.defconfig
```kconfig
# Copyright (c) 2025 Clickety Split Ltd.
# SPDX-License-Identifier: MIT

if BOARD_CLICKETY_SPLIT_MNML_3X6_LEFT

config ZMK_KEYBOARD_NAME
    default "MNML v2.13"

config ZMK_SPLIT_ROLE_CENTRAL
    default y

endif # BOARD_CLICKETY_SPLIT_MNML_3X6_LEFT

if BOARD_CLICKETY_SPLIT_MNML_3X6_LEFT || BOARD_CLICKETY_SPLIT_MNML_3X6_RIGHT

config BOARD
    default "clickety_split_mnml_3x6"

config ZMK_SPLIT
    default y

if USB

config USB_NRFX
    default y

config USB_DEVICE_STACK
    default y

endif # USB

endif # BOARD_CLICKETY_SPLIT_MNML_3X6_LEFT || BOARD_CLICKETY_SPLIT_MNML_3X6_RIGHT
```

## app/boards/clicketysplit/mnml/board.yml
```yaml
boards:
  - name: clickety_split_mnml_3x6_left
    vendor: clicketysplit
    socs:
      - name: nrf52840
        variants:
          - name: zmk

  - name: clickety_split_mnml_3x6_right
    vendor: clicketysplit
    socs:
      - name: nrf52840
        variants:
          - name: zmk

  - name: clickety_split_mnml_3x5_left
    vendor: clicketysplit
    socs:
      - name: nrf52840
        variants:
          - name: zmk

  - name: clickety_split_mnml_3x5_right
    vendor: clicketysplit
    socs:
      - name: nrf52840
        variants:
          - name: zmk
```

## app/boards/clicketysplit/mnml/clickety_split_mnml_3x6_right_nrf52840_zmk_defconfig
```kconfig
# Copyright (c) 2025 Clickety Split Ltd.
# SPDX-License-Identifier: MIT
#


# MCU
CONFIG_ARM_MPU=y
CONFIG_GPIO=y
CONFIG_PINCTRL=y
CONFIG_SPI_NRFX=y

# Bootloader and artifacts
CONFIG_USE_DT_CODE_PARTITION=y
CONFIG_BUILD_OUTPUT_UF2=y

# Use the external 32.768 kHz crystal fitted to the MNML hardware.
CONFIG_CLOCK_CONTROL_NRF=y
CONFIG_CLOCK_CONTROL_NRF_K32SRC_RC=n
CONFIG_CLOCK_CONTROL_NRF_K32SRC_XTAL=y

# Flash Partition settings
CONFIG_MPU_ALLOW_FLASH_WRITE=y
CONFIG_NVS=y
CONFIG_SETTINGS_NVS=y
CONFIG_FLASH=y
CONFIG_FLASH_PAGE_LAYOUT=y
CONFIG_FLASH_MAP=y

# Enable BLE for split communication
CONFIG_ZMK_BLE=y
CONFIG_BT_BAS=y

# Power Management
CONFIG_ZMK_SLEEP=y
CONFIG_ZMK_IDLE_TIMEOUT=30000
CONFIG_ZMK_IDLE_SLEEP_TIMEOUT=900000

CONFIG_ZMK_BATTERY_REPORTING=y
CONFIG_ZMK_EXT_POWER=y

# MAX17048 Fuel Gauge
CONFIG_ZMK_MAX17048=y
CONFIG_I2C=y
CONFIG_SENSOR=y

# Display Related Configuration Settings
CONFIG_ZMK_DISPLAY=y
CONFIG_ZMK_DISPLAY_WORK_QUEUE_DEDICATED=y
CONFIG_ZMK_DISPLAY_DEDICATED_THREAD_STACK_SIZE=4096
CONFIG_ZMK_DISPLAY_BLANK_ON_IDLE=y

# Sharp LS0XX is a 1-bit monochrome memory display.
CONFIG_LV_COLOR_DEPTH_1=y
CONFIG_LV_Z_BITS_PER_PIXEL=1
CONFIG_LV_USE_THEME_MONO=y
CONFIG_LV_Z_VDB_SIZE=100

# Set Screen Status and Font Size
CONFIG_ZMK_DISPLAY_STATUS_SCREEN_BUILT_IN=y
CONFIG_ZMK_LV_FONT_DEFAULT_SMALL_MONTSERRAT_12=y
CONFIG_LV_FONT_DEFAULT_MONTSERRAT_16=y

# Display Widgets
CONFIG_ZMK_WIDGET_WPM_STATUS=n
CONFIG_ZMK_WIDGET_BATTERY_STATUS=y
CONFIG_ZMK_WIDGET_BATTERY_STATUS_SHOW_PERCENTAGE=y

# BLE pairing
CONFIG_ZMK_BLE_PASSKEY_ENTRY=n
```

## app/boards/shields/clickety_split_leeloo/Kconfig.shield
```kconfig
# Copyright (c) 2023 The ZMK Contributors
# SPDX-License-Identifier: MIT

config SHIELD_CLICKETY_SPLIT_LEELOO
    bool

config SHIELD_CLICKETY_SPLIT_LEELOO_LEFT
    def_bool $(shields_list_contains,clickety_split_leeloo_left)
    select SHIELD_CLICKETY_SPLIT_LEELOO

config SHIELD_CLICKETY_SPLIT_LEELOO_RIGHT
    def_bool $(shields_list_contains,clickety_split_leeloo_right)
    select SHIELD_CLICKETY_SPLIT_LEELOO

config SHIELD_CLICKETY_SPLIT_LEELOO_REV2_LEFT
    def_bool $(shields_list_contains,clickety_split_leeloo_rev2_left)
    select SHIELD_CLICKETY_SPLIT_LEELOO

config SHIELD_CLICKETY_SPLIT_LEELOO_REV2_RIGHT
    def_bool $(shields_list_contains,clickety_split_leeloo_rev2_right)
    select SHIELD_CLICKETY_SPLIT_LEELOO

config SHIELD_CLICKETY_SPLIT_LEELOO_REV3_LEFT
    def_bool $(shields_list_contains,clickety_split_leeloo_rev3_left)
    select SHIELD_CLICKETY_SPLIT_LEELOO

config SHIELD_CLICKETY_SPLIT_LEELOO_REV3_RIGHT
    def_bool $(shields_list_contains,clickety_split_leeloo_rev3_right)
    select SHIELD_CLICKETY_SPLIT_LEELOO
```

## app/boards/shields/clickety_split_leeloo_micro/Kconfig.shield
```kconfig
# Copyright (c) 2023 The ZMK Contributors
# SPDX-License-Identifier: MIT

config SHIELD_CLICKETY_SPLIT_LEELOO_MICRO
    bool

config SHIELD_CLICKETY_SPLIT_LEELOO_MICRO_LEFT
    def_bool $(shields_list_contains,clickety_split_leeloo_micro_left)
    select SHIELD_CLICKETY_SPLIT_LEELOO_MICRO

config SHIELD_CLICKETY_SPLIT_LEELOO_MICRO_RIGHT
    def_bool $(shields_list_contains,clickety_split_leeloo_micro_right)
    select SHIELD_CLICKETY_SPLIT_LEELOO_MICRO
```

## app/dts/bindings/zmk,pm-gpio-rail.yaml
```yaml
# Copyright (c) 2026 The ZMK Contributors
# SPDX-License-Identifier: MIT

description: |
  GPIO-controlled rail that remains enabled during normal operation and
  ordinary idle, and is disabled during device-PM suspend before deep sleep.

compatible: "zmk,pm-gpio-rail"

properties:
  enable-gpios:
    type: phandle-array
    required: true
    description: GPIO used to enable the rail.

  init-delay-ms:
    type: int
    required: false
    description: Delay after enabling the rail during initialization or resume.
```

## app/module/boards/clickety_split/clickety_split_chiisai/Kconfig.defconfig
```kconfig
# Copyright (c) 2025 Clickety Split Ltd.
# SPDX-License-Identifier: MIT

if BOARD_CLICKETY_SPLIT_CHIISAI

if USB_DEVICE_STACK

config USB_NRFX
    default y

endif # USB_DEVICE_STACK

config BT_CTLR
    default BT

endif # BOARD_CLICKETY_SPLIT_CHIISAI
```
