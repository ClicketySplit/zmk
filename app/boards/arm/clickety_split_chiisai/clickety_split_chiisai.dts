/*
 * Copyright (c) 2025 Clickety Split Ltd.
 * SPDX-License-Identifier: MIT
 */

/dts-v1/;
#include "clickety_split_chiisai.dtsi"

/ {
    chosen {
        zmk,battery = &vbatt;
    };

    // Node name must match original "EXT_POWER" label to preserve user settings.
    EXT_POWER {
        compatible = "zmk,ext-power-generic";
        control-gpios = <&gpio0 6 GPIO_ACTIVE_HIGH>;
        init-delay-ms = <50>;
    };

    vbatt: vbatt {
        compatible = "zmk,battery-nrf-vddh";
    };
};
