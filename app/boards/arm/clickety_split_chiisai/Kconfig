## app/boards/arm/clickety_split_chiisai/Kconfig
```kconfig
# Copyright (c) 2025 Clickety Split Ltd.
# SPDX-License-Identifier: MIT

config BOARD_ENABLE_DCDC
    bool "Enable DCDC Converter"
    select SOC_DCDC_NRF52X
    default y
    depends on (BOARD_CLICKETY_SPLIT_CHIISAI)

#
# NOTE: This section is not compatible with BC840M,
#       nor the uBlox NINA-B306
#
# config BOARD_ENABLE_DCDC_HV
#     bool "Enable High-Voltage DCDC Converter"
#     select SOC_DCDC_NRF52X_HV
#     default y
#     depends on (BOARD_CLICKETY_SPLIT_CHIISAI)
```

## app/boards/arm/clickety_split_chiisai/Kconfig.board
```kconfig
# Chiisai v1.13 board configuration

# Copyright (c) 2025 Clickety Split Ltd.
# SPDX-License-Identifier: MIT

config BOARD_CLICKETY_SPLIT_CHIISAI
    bool "Clickety Split Chiisai"
    depends on SOC_NRF52840_QIAA
```

## app/boards/arm/clickety_split_chiisai/Kconfig.defconfig
```kconfig
# Copyright (c) 2025 Clickety Split Ltd.
# SPDX-License-Identifier: MIT

if BOARD_CLICKETY_SPLIT_CHIISAI

config BOARD
    default "clickety_split_chiisai"

config BT_CTLR
    default BT

if USB_DEVICE_STACK

config USB_NRFX
    default y

endif # USB_DEVICE_STACK

endif # BOARD_CLICKETY_SPLIT_CHIISAI
```

## app/boards/arm/clickety_split_mnml/Kconfig.board
```kconfig
# Copyright (c) 2025 Clickety Split Ltd.
# SPDX-License-Identifier: MIT
#

config BOARD_CLICKETY_SPLIT_MNML_LEFT
    bool "clickety_split_mnml_left"
    depends on SOC_NRF52840_QIAA
    select ZMK_SPLIT
    select ZMK_SPLIT_ROLE_CENTRAL

config BOARD_CLICKETY_SPLIT_MNML_RIGHT
    bool "clickety_split_mnml_right"
    depends on SOC_NRF52840_QIAA
    select ZMK_SPLIT
```

## app/boards/arm/clickety_split_mnml/Kconfig.defconfig
```kconfig
# Copyright (c) 2025 Clickety Split Ltd.
# SPDX-License-Identifier: MIT
#

if BOARD_CLICKETY_SPLIT_MNML_LEFT

config ZMK_KEYBOARD_NAME
    default "MNML v2.13"

config ZMK_SPLIT_ROLE_CENTRAL
    default y

endif # BOARD_CLICKETY_SPLIT_MNML_LEFT


if BOARD_CLICKETY_SPLIT_MNML_LEFT || BOARD_CLICKETY_SPLIT_MNML_RIGHT

config BOARD
    default "clickety_split_mnml"

config BT_CTLR
    default BT

if USB_DEVICE_STACK

config USB_NRFX
    default y

endif # USB_DEVICE_STACK

endif # BOARD_CLICKETY_SPLIT_MNML_LEFT || BOARD_CLICKETY_SPLIT_MNML_RIGHT
```

## app/boards/arm/clickety_split_mnml/clickety_split_mnml_left_defconfig
```kconfig
# Copyright (c) 2025 Clickety Split Ltd.
# SPDX-License-Identifier: MIT
#

CONFIG_SOC_SERIES_NRF52X=y
CONFIG_SOC_NRF52840_QIAA=y
CONFIG_BOARD_CLICKETY_SPLIT_MNML_LEFT=y

# MCU
CONFIG_ARM_MPU=y
CONFIG_GPIO=y
CONFIG_PINCTRL=y
CONFIG_SPI_NRFX=y

# Bootloader and artifacts
CONFIG_USE_DT_CODE_PARTITION=y
CONFIG_BUILD_OUTPUT_UF2=y

# Use RC oscillator for 32kHz of the BC840M
CONFIG_CLOCK_CONTROL_NRF=y
CONFIG_CLOCK_CONTROL_NRF_K32SRC_RC=y

# If an external 32.768kHz Crystal is installed.
CONFIG_CLOCK_CONTROL_NRF_K32SRC_XTAL=y

# Flash Partition settings
CONFIG_MPU_ALLOW_FLASH_WRITE=y
CONFIG_NVS=y
CONFIG_SETTINGS_NVS=y
CONFIG_FLASH=y
CONFIG_FLASH_PAGE_LAYOUT=y
CONFIG_FLASH_MAP=y

# Enable both USB and BLE
CONFIG_ZMK_BLE=y
CONFIG_ZMK_USB=y
CONFIG_BT_BAS=y

# Power Management
CONFIG_ZMK_SLEEP=y
CONFIG_ZMK_IDLE_TIMEOUT=30000
CONFIG_ZMK_IDLE_SLEEP_TIMEOUT=900000

CONFIG_ZMK_BATTERY_REPORTING=y
CONFIG_ZMK_EXT_POWER=y

# MAX17048 Fuel Gauge
CONFIG_ZMK_MAX17048=y
CONFIG_I2C=y
CONFIG_SENSOR=y

# Display Related Configuration Settings
CONFIG_ZMK_DISPLAY=y

# Set Screen Status and Font Size
CONFIG_ZMK_DISPLAY_STATUS_SCREEN_BUILT_IN=y
CONFIG_ZMK_LV_FONT_DEFAULT_SMALL_MONTSERRAT_24=y
CONFIG_LV_FONT_DEFAULT_MONTSERRAT_24=y
CONFIG_ZMK_DISPLAY_WORK_QUEUE_DEDICATED=y

# Display Widgets
CONFIG_ZMK_WIDGET_WPM_STATUS=n
CONFIG_ZMK_WIDGET_BATTERY_STATUS=y
CONFIG_ZMK_WIDGET_BATTERY_STATUS_SHOW_PERCENTAGE=y

# Miscellaneous Settings and Logging
CONFIG_ZMK_BLE_PASSKEY_ENTRY=n
#CONFIG_BT_CTLR_TX_PWR_PLUS_8=y

# If you need to clear left | right bonds between nice!nanos.
# CONFIG_ZMK_BLE_CLEAR_BONDS_ON_START=y

# Experimental
# CONFIG_ZMK_BLE_EXPERIMENTAL_CONN=y
# CONFIG_ZMK_BLE_EXPERIMENTAL_FEATURES=y
# CONFIG_BT_GATT_ENFORCE_SUBSCRIPTION=n

# Turn on logging, and set ZMK logging to debug output
# CONFIG_LOG=y
# CONFIG_ZMK_LOG_LEVEL_DBG=y
# CONFIG_ZMK_USB_LOGGING=y
# CONFIG_LOG_PROCESS_THREAD_STARTUP_DELAY_MS=10000
```

## app/boards/arm/clickety_split_mnml_3x6/Kconfig.board
```kconfig
# Copyright (c) 2025 Clickety Split Ltd.
# SPDX-License-Identifier: MIT
#

config BOARD_CLICKETY_SPLIT_MNML_3x6_LEFT
    bool "clickety_split_mnml_3x6_left"
    depends on SOC_NRF52840_QIAA
    select ZMK_SPLIT
    select ZMK_SPLIT_ROLE_CENTRAL

config BOARD_CLICKETY_SPLIT_MNML_3x6_RIGHT
    bool "clickety_split_mnml_3x6_right"
    depends on SOC_NRF52840_QIAA
    select ZMK_SPLIT
```

## app/boards/arm/clickety_split_mnml_3x6/Kconfig.defconfig
```kconfig
# Copyright (c) 2025 Clickety Split Ltd.
# SPDX-License-Identifier: MIT
#

if BOARD_CLICKETY_SPLIT_MNML_3x6_LEFT

config ZMK_KEYBOARD_NAME
    default "MNML v2.13"

config ZMK_SPLIT_ROLE_CENTRAL
    default y

endif # BOARD_CLICKETY_SPLIT_MNML_3x6_LEFT


if BOARD_CLICKETY_SPLIT_MNML_3x6_LEFT || BOARD_CLICKETY_SPLIT_MNML_3x6_RIGHT

config BOARD
    default "clickety_split_mnml_3x6"

config BT_CTLR
    default BT

if USB_DEVICE_STACK

config USB_NRFX
    default y

endif # USB_DEVICE_STACK

endif # BOARD_CLICKETY_SPLIT_MNML_3x6_LEFT || BOARD_CLICKETY_SPLIT_MNML_3x6_RIGHT
```
