/*
 * Copyright (c) 2026 Clickety Split Ltd.
 * SPDX-License-Identifier: MIT
 */

#include "../../clickety_split_leeloo_micro_rev2_chiisai_rgb.dtsi"
#include "../../clickety_split_leeloo_micro_rev2_chiisai_mip.dtsi"
